// =====================================================================
//  TVC two-motor lander: flight software for LilyGO T-Beam Supreme (ESP32-S3)
//  Generated by TVC Motor Lab from the current model. Re-generate after every
//  change to masses, motors, delay or drag. Model-based numbers: verify on the
//  bench before flight.
//
//  Ascent GATI F-20 (72 N·s)  ->  Descent GATI E-30 (30.6 N·s)
//  Liftoff mass 1170 g, landing mass 1015 g, matched light speed v* = 23.1 m/s
//
//  Arduino IDE: board "ESP32S3 Dev Module", USB CDC On Boot: Enabled, Flash 8MB,
//  PSRAM: QSPI PSRAM, Partition: 8M Flash (3M APP/1.5MB SPIFFS).
//  Libraries (from the LilyGo-LoRa-Series repo /lib folder):
//    SensorLib (QMI8658), XPowersLib (AXP2101), Adafruit_BME280 + Adafruit_Sensor + Adafruit_BusIO, U8g2
// =====================================================================
#include <Arduino.h>
#include <Wire.h>
#include <SPI.h>
#include <SD.h>
#include "SensorQMI8658.hpp"
#include <XPowersAXP2101.tpp>
#include <Adafruit_BME280.h>
#include <U8g2lib.h>

// ---------------- pins (T-Beam Supreme headers) ----------------
// Board-internal: I2C0 SDA17/SCL18 (BME280, OLED, mag), I2C1 SDA42/SCL41 (AXP2101),
// shared SPI MOSI35/MISO37/SCK36, IMU CS34, SD CS47, BOOT button 0.
#define PIN_SERVO_PITCH   38   // header PN1 pin 8  -> pitch (outer ring) servo signal
#define PIN_SERVO_YAW     39   // header PN1 pin 7  -> yaw (inner ring) servo signal
#define PIN_PYRO_DESCENT  21   // header PN1 pin 12 -> MOSFET gate, descent igniter
#define PIN_CHUTE         48   // header PN1 pin 13 -> failsafe parachute (servo or 2nd MOSFET)
#define PIN_FLARE         46   // header PN1 pin 5  -> nose flare release servo (strapping pin: output only after boot)
#define PIN_CONT_ADC      3    // header PN1 pin 10 -> igniter continuity divider (ADC1_CH2)
#define PIN_BUTTON        0    // on-board BOOT button: calibrate / arm on the pad
// Do NOT use GPIO45 (sets flash voltage at reset) or GPIO43 (boot log TX) for anything that can fire.

#define CHUTE_IS_SERVO    1    // 1 = hatch servo releases the chute, 0 = PIN_CHUTE drives a pyro MOSFET
#define USE_FLARE         1    // 1 = nose drag flare opened at apogee (strongly recommended)

// ---------------- vehicle model (from TVC Motor Lab) ----------------
const float G0 = 9.80665f;
const float MASS_PRE_SEP_KG = 1.100f;
const float CDA_FALL_M2     = 0.02881f;   // Cd*A while falling (flare open)
const float I_ASC = 0.08884f, ARM_ASC = 0.269f;   // kg m^2, pivot->CG [m] at liftoff
const float I_DES = 0.06724f, ARM_DES = 0.326f;   // during landing burn
const float GIMBAL_MAX_DEG = 6.6f;

// expected thrust curves, 50 ms steps (from the motor data in the Mission tab)
const float CURVE_DT = 0.050f;
const int   ASC_N = 59;
const float ASC_F[ASC_N] = {
  0.0f, 26.6f, 53.2f, 52.2f, 51.1f, 50.1f, 49.1f, 48.1f, 47.1f, 46.0f,
  45.0f, 44.0f, 43.0f, 42.0f, 40.9f, 39.9f, 38.9f, 37.9f, 36.9f, 35.8f,
  34.8f, 33.8f, 32.8f, 31.8f, 30.7f, 29.7f, 28.7f, 27.7f, 26.7f, 25.6f,
  24.6f, 23.6f, 22.6f, 21.6f, 20.6f, 19.5f, 18.5f, 17.5f, 16.5f, 15.5f,
  14.4f, 13.4f, 12.4f, 11.4f, 10.4f, 9.3f, 8.3f, 7.3f, 6.3f, 5.3f,
  4.2f, 3.2f, 2.2f, 1.2f, 0.2f, 0.0f, 0.0f, 0.0f, 0.0f
};
const int   DES_N = 27;
const float DES_F[DES_N] = {
  0.0f, 21.0f, 42.0f, 40.8f, 39.6f, 38.3f, 37.1f, 35.9f, 34.7f, 33.4f,
  32.2f, 31.0f, 29.8f, 28.6f, 27.3f, 26.1f, 24.9f, 23.7f, 22.4f, 21.2f,
  20.0f, 3.3f, 0.0f, 0.0f, 0.0f, 0.0f, 0.0f
};

// ---------------- landing trigger ----------------
const float IGN_DELAY_S = 0.150f;    // command -> thrust. MEASURE on the bench and update
const float TRIG_BIAS_M = 0.00f;
const float TBL_V0 = 1.0f, TBL_DV = 1.0f;
const int   TBL_N  = 36;
const float TBL_H[TBL_N] = {   // altitude of leg tips at which thrust must start, vs speed at light
  0.06f, 0.16f, 0.30f, 0.47f, 0.67f, 0.90f, 1.17f, 1.47f, 1.80f, 2.16f,
  2.55f, 2.98f, 3.44f, 3.92f, 4.45f, 5.00f, 5.58f, 6.19f, 6.84f, 7.52f,
  8.22f, 8.97f, 9.74f, 10.55f, 11.34f, 12.13f, 12.90f, 13.66f, 14.42f, 15.17f,
  15.90f, 16.62f, 17.34f, 18.05f, 18.75f, 19.45f
};
const float SPEED_MIN = 19.0f, SPEED_MAX = 30.0f;  // light-speed window (touchdown <= 5 m/s)
const float H_CMD_NOM = 14.5f;          // nominal command height [m]
const float DECIDE_M  = 40.0f;         // go / no-go height (raise to where your chute still opens)
const float MAX_TILT_DEG = 15.0f;
const float APOGEE_BACKUP_S = 8.7f;  // force apogee state this long after liftoff

// ---------------- TVC controller ----------------
const float WN = 8.0f, ZETA = 0.7f, KI = 3.0f;    // closed-loop attitude dynamics
const float SERVO_PER_GIMBAL = 2.2f;   // servo horn degrees per gimbal degree: MEASURE with a protractor
const int   SERVO_US_CENTER_P = 1500, SERVO_US_CENTER_Y = 1500;  // trims
const float SERVO_US_PER_DEG = 10.0f;  // typical; check your servo's travel
const int   SERVO_DIR_P = +1, SERVO_DIR_Y = +1;  // flip if the bench test shows the wrong direction
const int   SERVO_HZ = 50;             // raise to 100-200 only if your servos are digital
const float SERVO_HORN_MAX_DEG = 40.0f;
// body axes in the IMU frame. UP is measured on the pad. PITCH_REF is the IMU axis that points
// toward the pitch servo's push side; it is made perpendicular to UP automatically.
float PITCH_REF[3] = {1, 0, 0};

// ---------------- chute / flare servo positions ----------------
const int CHUTE_US_CLOSED = 1000, CHUTE_US_OPEN = 2000;
const int FLARE_US_CLOSED = 1000, FLARE_US_OPEN = 2000;

// =====================================================================
SensorQMI8658 imu;
Adafruit_BME280 bme;
XPowersAXP2101 pmu;
U8G2_SH1106_128X64_NONAME_F_HW_I2C oled(U8G2_R0, U8X8_PIN_NONE, 18, 17);   // clock 18, data 17

void oledMsg(const char *a, const char *b);
void setState(int s);

enum State { PAD_IDLE, PAD_ARMED, BOOST, COAST, DESCENT, GO, LANDING_BURN, LANDED, FAILSAFE, BENCH_TEST };
volatile int state = PAD_IDLE;
const char *STATE_NAME[] = {"PAD_IDLE", "PAD_ARMED", "BOOST", "COAST", "DESCENT", "GO", "LANDING_BURN", "LANDED", "FAILSAFE", "BENCH_TEST"};

struct Q { float w, x, y, z; };
Q q = {1, 0, 0, 0};
float gyroBias[3] = {0, 0, 0};
float bUp[3] = {0, 0, 1}, bP[3] = {1, 0, 0}, bY[3] = {0, 1, 0};
float p0 = 101325.0f;
// vertical Kalman filter state: altitude of leg tips above the pad, vertical speed (up +)
float kh = 0, kv = 0, P11 = 1, P12 = 0, P22 = 1;
float aVert = 0, tiltDeg = 0, thP = 0, thY = 0, rP = 0, rY = 0, iP = 0, iY = 0;
float dPcmd = 0, dYcmd = 0, maxAlt = 0;
uint32_t tLiftMs = 0, tCmdMs = 0, tStateMs = 0, lastBaroUs = 0, lastLoopUs = 0, lastServoUs = 0, lastLogUs = 0, lastPrintMs = 0, belowCount = 0, tumbleMs = 0;
bool pyroFired = false, pyroOn = false; uint32_t pyroOnMs = 0;
float baroAlt = 0, contV = 0;

// ---------------- servo PWM (LEDC, works on Arduino-ESP32 2.x and 3.x) ----------------
#if defined(ESP_ARDUINO_VERSION_MAJOR) && ESP_ARDUINO_VERSION_MAJOR >= 3
void pwmSetup(int pin, int ch) { (void)ch; ledcAttach(pin, SERVO_HZ, 14); }
void pwmWriteUs(int pin, int ch, int us) { (void)ch; ledcWrite(pin, (uint32_t)((uint64_t)us * 16383ULL * SERVO_HZ / 1000000ULL)); }
#else
void pwmSetup(int pin, int ch) { ledcSetup(ch, SERVO_HZ, 14); ledcAttachPin(pin, ch); }
void pwmWriteUs(int pin, int ch, int us) { (void)pin; ledcWrite(ch, (uint32_t)((uint64_t)us * 16383ULL * SERVO_HZ / 1000000ULL)); }
#endif
enum { CH_P = 0, CH_Y = 1, CH_CHUTE = 2, CH_FLARE = 3 };

// ---------------- helpers ----------------
static inline float clampf(float x, float a, float b) { return x < a ? a : (x > b ? b : x); }
static inline float dot3(const float *a, const float *b) { return a[0] * b[0] + a[1] * b[1] + a[2] * b[2]; }
static void cross3(const float *a, const float *b, float *o) { o[0] = a[1] * b[2] - a[2] * b[1]; o[1] = a[2] * b[0] - a[0] * b[2]; o[2] = a[0] * b[1] - a[1] * b[0]; }
static void norm3(float *a) { float n = sqrtf(dot3(a, a)); if (n > 1e-9f) { a[0] /= n; a[1] /= n; a[2] /= n; } }
// rotate a body-frame vector into the world frame (q: body -> world)
static void rotB2W(const Q &qq, const float *v, float *o) {
  float w = qq.w, x = qq.x, y = qq.y, z = qq.z;
  o[0] = (1 - 2 * (y * y + z * z)) * v[0] + 2 * (x * y - w * z) * v[1] + 2 * (x * z + w * y) * v[2];
  o[1] = 2 * (x * y + w * z) * v[0] + (1 - 2 * (x * x + z * z)) * v[1] + 2 * (y * z - w * x) * v[2];
  o[2] = 2 * (x * z - w * y) * v[0] + 2 * (y * z + w * x) * v[1] + (1 - 2 * (x * x + y * y)) * v[2];
}
static void rotW2B(const Q &qq, const float *v, float *o) { Q c = {qq.w, -qq.x, -qq.y, -qq.z}; rotB2W(c, v, o); }

float curveAt(const float *c, int n, float t) {
  if (t < 0) return 0;
  float x = t / CURVE_DT; int i = (int)x;
  if (i >= n - 1) return 0;
  return c[i] + (c[i + 1] - c[i]) * (x - i);
}
float trigHeight(float v) {
  float x = (v - TBL_V0) / TBL_DV;
  if (x <= 0) return TBL_H[0];
  if (x >= TBL_N - 1) return TBL_H[TBL_N - 1];
  int i = (int)x; float fr = x - i; return TBL_H[i] + (TBL_H[i + 1] - TBL_H[i]) * fr;
}
float speedAt(float alt, float vDown, float hTo) {   // drag-aware fall-speed prediction
  float vt2 = 2.0f * MASS_PRE_SEP_KG * G0 / (1.2f * CDA_FALL_M2);
  float dh = alt - hTo; if (dh < 0) dh = 0;
  return sqrtf(fmaxf(0.0f, vt2 + (vDown * vDown - vt2) * expf(-2.0f * G0 * dh / vt2)));
}
bool shouldIgnite(float alt, float vDown) {
  float rho = 1.225f * expf(-alt / 8500.0f);
  float a = G0 - 0.5f * rho * CDA_FALL_M2 * vDown * vDown / MASS_PRE_SEP_KG;
  float vP = vDown + a * IGN_DELAY_S;
  float hP = alt - vDown * IGN_DELAY_S - 0.5f * a * IGN_DELAY_S * IGN_DELAY_S;
  return hP <= trigHeight(vP) + TRIG_BIAS_M;
}

// ---------------- flight log in PSRAM, written to SD after landing ----------------
struct LogRec { uint32_t ms; uint8_t st; float h, v, a, baro, tilt, thP, thY, dP, dY; };
const int LOG_MAX = 40000;   // 400 s at 100 Hz (~1.8 MB of the 8 MB PSRAM)
LogRec *logBuf = nullptr; int logN = 0;
void logSample() { if (logBuf && logN < LOG_MAX) logBuf[logN++] = {millis(), (uint8_t)state, kh, kv, aVert, baroAlt, tiltDeg, thP, thY, dPcmd, dYcmd}; }
void writeLog() {
  if (!logBuf || logN == 0) return;
  if (!SD.begin(47, SPI)) { Serial.println("SD failed"); return; }
  char name[24]; for (int i = 0; i < 1000; i++) { snprintf(name, sizeof(name), "/flight%03d.csv", i); if (!SD.exists(name)) break; }
  File fl = SD.open(name, FILE_WRITE); if (!fl) return;
  fl.println("ms,state,alt_m,vz_ms,az_ms2,baro_m,tilt_deg,thP_deg,thY_deg,gimP_deg,gimY_deg");
  for (int i = 0; i < logN; i++) { LogRec &r = logBuf[i];
    fl.printf("%lu,%u,%.2f,%.2f,%.2f,%.2f,%.1f,%.2f,%.2f,%.2f,%.2f\n", (unsigned long)r.ms, r.st, r.h, r.v, r.a, r.baro, r.tilt, r.thP, r.thY, r.dP, r.dY); }
  fl.close(); Serial.printf("log written: %s (%d rows)\n", name, logN);
}

// ---------------- power, sensors ----------------
void beginPower() {
  pmu.begin(Wire1, AXP2101_SLAVE_ADDRESS, 42, 41);
  pmu.disableALDO1(); pmu.disableALDO2(); delay(250);         // same reset sequence as LilyGO's board code
  pmu.setALDO1Voltage(3300); pmu.enableALDO1();               // BME280, OLED, magnetometer
  pmu.setALDO2Voltage(3300); pmu.enableALDO2();               // IMU
  pmu.setBLDO1Voltage(3300); pmu.enableBLDO1();               // SD card
  pmu.disableALDO4();                                         // GPS not used: saves power and noise
}
float readBaroAlt() { return 44330.0f * (1.0f - powf(bme.readPressure() / p0, 0.1903f)); }

void calibratePad() {   // rocket standing still and vertical on its legs
  oledMsg("CALIBRATING", "keep still 3 s");
  float acc[3] = {0, 0, 0}, gb[3] = {0, 0, 0}; int n = 0; double pSum = 0; int np = 0;
  uint32_t t0 = millis();
  uint32_t tb = 0;
  while (millis() - t0 < 3000) {
    float ax, ay, az, gx, gy, gz;
    if (imu.getDataReady() && imu.getAccelerometer(ax, ay, az) && imu.getGyroscope(gx, gy, gz)) {
      acc[0] += ax; acc[1] += ay; acc[2] += az; gb[0] += gx; gb[1] += gy; gb[2] += gz; n++; }
    if (millis() - tb >= 20) { tb = millis(); pSum += bme.readPressure(); np++; }
  }
  if (n < 100 || np < 10) { oledMsg("CAL FAILED", "check sensors"); return; }
  for (int i = 0; i < 3; i++) { bUp[i] = acc[i] / n; gyroBias[i] = gb[i] / n; }
  norm3(bUp);                                       // accelerometer reads +1 g along "up" at rest
  float pr = dot3(PITCH_REF, bUp); for (int i = 0; i < 3; i++) bP[i] = PITCH_REF[i] - pr * bUp[i]; norm3(bP);
  cross3(bUp, bP, bY);                              // yaw-plane axis completes a right-handed set
  p0 = (float)(pSum / np);
  // initial attitude: body "up" aligned with world +Z
  float zw[3] = {0, 0, 1}, ax[3]; cross3(bUp, zw, ax); float s = sqrtf(dot3(ax, ax)), c = dot3(bUp, zw);
  if (s < 1e-6f) q = {1, 0, 0, 0}; else { float ang = atan2f(s, c); norm3(ax); float h = 0.5f * ang; q = {cosf(h), ax[0] * sinf(h), ax[1] * sinf(h), ax[2] * sinf(h)}; }
  kh = 0; kv = 0; P11 = 1; P12 = 0; P22 = 1; iP = iY = 0;
}

// ---------------- estimator ----------------
void updateAttitude(float gx, float gy, float gz, float dt) {   // gyro in deg/s
  const float d2r = 0.01745329f;
  float wx = (gx - gyroBias[0]) * d2r, wy = (gy - gyroBias[1]) * d2r, wz = (gz - gyroBias[2]) * d2r;
  Q d = {0.5f * (-q.x * wx - q.y * wy - q.z * wz), 0.5f * (q.w * wx + q.y * wz - q.z * wy), 0.5f * (q.w * wy - q.x * wz + q.z * wx), 0.5f * (q.w * wz + q.x * wy - q.y * wx)};
  q.w += d.w * dt; q.x += d.x * dt; q.y += d.y * dt; q.z += d.z * dt;
  float n = sqrtf(q.w * q.w + q.x * q.x + q.y * q.y + q.z * q.z); q.w /= n; q.x /= n; q.y /= n; q.z /= n;
  // tilt components in the two servo planes and their rates
  float zw[3] = {0, 0, 1}, up_b[3]; rotW2B(q, zw, up_b);
  float u = dot3(up_b, bUp);
  thP = atan2f(-dot3(up_b, bP), u) * 57.2958f;     // + = rocket leaning toward the pitch servo side
  thY = atan2f(-dot3(up_b, bY), u) * 57.2958f;
  tiltDeg = acosf(clampf(u, -1, 1)) * 57.2958f;
  float w[3] = {wx, wy, wz}, kP[3], kY[3]; cross3(bUp, bP, kP); cross3(bUp, bY, kY);
  rP = dot3(w, kP); rY = dot3(w, kY);               // rad/s, + = leaning further
}
void kalmanPredict(float ax, float ay, float az, float dt) {   // accel in g
  float ab[3] = {ax * G0, ay * G0, az * G0}, aw[3]; rotB2W(q, ab, aw);
  aVert = aw[2] - G0;
  kh += kv * dt + 0.5f * aVert * dt * dt; kv += aVert * dt;
  const float qa = 1.0f;   // accel noise (m/s^2)^2
  P11 += dt * (2 * P12 + dt * P22) + 0.25f * dt * dt * dt * dt * qa; P12 += dt * P22 + 0.5f * dt * dt * dt * qa; P22 += dt * dt * qa;
}
void kalmanBaro(float z) {
  const float R = (state == BOOST || state == LANDING_BURN) ? 4.0f : 0.09f;   // distrust baro under thrust
  float S = P11 + R, k1 = P11 / S, k2 = P12 / S, y = z - kh;
  kh += k1 * y; kv += k2 * y; float p11 = P11, p12 = P12; P11 -= k1 * p11; P12 -= k1 * p12; P22 -= k2 * p12;
}

// ---------------- TVC ----------------
float gimbalCmd(float th, float rate, float &integ, float F, float I, float arm, float dt) {
  float thr = th * 0.01745329f;
  integ = clampf(integ + thr * dt, -0.3f, 0.3f);
  float aCmd = WN * WN * thr + 2.0f * ZETA * WN * rate + KI * integ;     // desired correction, rad/s^2
  float s = clampf(I * aCmd / (fmaxf(F, 1.0f) * arm), -sinf(GIMBAL_MAX_DEG * 0.01745329f), sinf(GIMBAL_MAX_DEG * 0.01745329f));
  return asinf(s) * 57.2958f;   // gimbal angle, deg (+ swings thrust toward the lean, pushing the tail under the nose)
}
void writeServos(float gP, float gY) {
  float hp = clampf(gP * SERVO_PER_GIMBAL, -SERVO_HORN_MAX_DEG, SERVO_HORN_MAX_DEG);
  float hy = clampf(gY * SERVO_PER_GIMBAL, -SERVO_HORN_MAX_DEG, SERVO_HORN_MAX_DEG);
  pwmWriteUs(PIN_SERVO_PITCH, CH_P, SERVO_US_CENTER_P + (int)(SERVO_DIR_P * hp * SERVO_US_PER_DEG));
  pwmWriteUs(PIN_SERVO_YAW, CH_Y, SERVO_US_CENTER_Y + (int)(SERVO_DIR_Y * hy * SERVO_US_PER_DEG));
}

// ---------------- actuators ----------------
void firePyro() { digitalWrite(PIN_PYRO_DESCENT, HIGH); pyroOn = true; pyroOnMs = millis(); pyroFired = true; }
void deployChute() {
#if CHUTE_IS_SERVO
  pwmWriteUs(PIN_CHUTE, CH_CHUTE, CHUTE_US_OPEN);
#else
  digitalWrite(PIN_CHUTE, HIGH);
#endif
}
void openFlare() {
#if USE_FLARE
  pwmWriteUs(PIN_FLARE, CH_FLARE, FLARE_US_OPEN);
#endif
}
float readContinuity() {   // volts at the MOSFET drain (scaled back up through the 100k/22k divider)
  return analogReadMilliVolts(PIN_CONT_ADC) / 1000.0f * (122.0f / 22.0f);
}
void oledMsg(const char *a, const char *b) {
  oled.clearBuffer(); oled.setFont(u8g2_font_6x10_tf); oled.drawStr(0, 12, a); oled.drawStr(0, 28, b); oled.sendBuffer();
}

void setState(int s) { state = s; tStateMs = millis(); Serial.printf("[%lu] -> %s  h=%.1f v=%.1f\n", (unsigned long)millis(), STATE_NAME[s], kh, kv); }

// =====================================================================
void setup() {
  pinMode(PIN_PYRO_DESCENT, OUTPUT); digitalWrite(PIN_PYRO_DESCENT, LOW);   // FIRST: hold the igniter off
#if !CHUTE_IS_SERVO
  pinMode(PIN_CHUTE, OUTPUT); digitalWrite(PIN_CHUTE, LOW);
#endif
  pinMode(PIN_BUTTON, INPUT_PULLUP);
  Serial.begin(115200); delay(300);
  beginPower();
  Wire.begin(17, 18, 400000);
  oled.begin();
  bool okI = imu.begin(SPI, 34, 35, 37, 36);
  bool okB = bme.begin(0x77, &Wire);
  if (okI) {
    imu.configAccelerometer(SensorQMI8658::ACC_RANGE_16G, SensorQMI8658::ACC_ODR_1000Hz, SensorQMI8658::LPF_MODE_0);
    imu.configGyroscope(SensorQMI8658::GYR_RANGE_1024DPS, SensorQMI8658::GYR_ODR_896_8Hz, SensorQMI8658::LPF_MODE_3);
    imu.enableGyroscope(); imu.enableAccelerometer();
  }
  if (okB) bme.setSampling(Adafruit_BME280::MODE_NORMAL, Adafruit_BME280::SAMPLING_X1, Adafruit_BME280::SAMPLING_X4,
                           Adafruit_BME280::SAMPLING_NONE, Adafruit_BME280::FILTER_X4, Adafruit_BME280::STANDBY_MS_0_5);
  pwmSetup(PIN_SERVO_PITCH, CH_P); pwmSetup(PIN_SERVO_YAW, CH_Y);
#if CHUTE_IS_SERVO
  pwmSetup(PIN_CHUTE, CH_CHUTE); pwmWriteUs(PIN_CHUTE, CH_CHUTE, CHUTE_US_CLOSED);
#endif
#if USE_FLARE
  pwmSetup(PIN_FLARE, CH_FLARE); pwmWriteUs(PIN_FLARE, CH_FLARE, FLARE_US_CLOSED);
#endif
  writeServos(0, 0);
  analogReadResolution(12);
  logBuf = (LogRec *)ps_malloc(sizeof(LogRec) * LOG_MAX);
  if (!okI || !okB) { oledMsg(okI ? "BARO FAIL" : "IMU FAIL", "do not fly"); while (1) delay(1000); }
  // hold BOOT while powering up (after the board has started) for the servo bench test
  delay(500);
  if (digitalRead(PIN_BUTTON) == LOW) { delay(1500); if (digitalRead(PIN_BUTTON) == LOW) { calibratePad(); setState(BENCH_TEST); oledMsg("BENCH TEST", "no motors fitted!"); return; } }
  oledMsg("READY", "BOOT=calibrate+arm");
  lastLoopUs = micros();
}

void loop() {
  uint32_t now = micros(); float dt = (now - lastLoopUs) * 1e-6f;
  // ---- IMU at ~900 Hz ----
  float ax, ay, az, gx, gy, gz;
  if (!(imu.getDataReady() && imu.getAccelerometer(ax, ay, az) && imu.getGyroscope(gx, gy, gz))) return;
  lastLoopUs = now; if (dt <= 0 || dt > 0.05f) dt = 0.001f;
  if (state != PAD_IDLE) { updateAttitude(gx, gy, gz, dt); kalmanPredict(ax, ay, az, dt); }
  // ---- barometer at ~70 Hz ----
  if (now - lastBaroUs > 14000) { lastBaroUs = now; baroAlt = readBaroAlt(); if (state != PAD_IDLE) kalmanBaro(baroAlt); }
  float accG = sqrtf(ax * ax + ay * ay + az * az);
  float tFlight = tLiftMs ? (millis() - tLiftMs) / 1000.0f : 0;
  if (kh > maxAlt) maxAlt = kh;

  // ---- pyro pulse length ----
  if (pyroOn && millis() - pyroOnMs > 1000) { digitalWrite(PIN_PYRO_DESCENT, LOW); pyroOn = false; }

  // ---- state machine ----
  switch (state) {
    case PAD_IDLE:
      if (digitalRead(PIN_BUTTON) == LOW) {
        delay(300); calibratePad(); contV = readContinuity();
        char b[32]; snprintf(b, sizeof b, "igniter %s %.1fV", contV > 2.0f ? "OK" : "OPEN", contV);
        oledMsg("ARMED - on legs", b); setState(PAD_ARMED);
      }
      break;
    case PAD_ARMED: {
      // keep attitude, gyro bias and altitude fresh while waiting (rocket standing still on its legs)
      if (accG < 1.1f && accG > 0.9f) {
        float a[3] = {ax / accG, ay / accG, az / accG}, zw[3] = {0, 0, 1}, axv[3]; cross3(a, zw, axv);
        float s = sqrtf(dot3(axv, axv)), c = dot3(a, zw);
        if (s > 1e-6f) { float ang = atan2f(s, c); norm3(axv); float h = 0.5f * ang; Q qa = {cosf(h), axv[0] * sinf(h), axv[1] * sinf(h), axv[2] * sinf(h)};
          const float k = 0.02f; q.w += k * (qa.w - q.w); q.x += k * (qa.x - q.x); q.y += k * (qa.y - q.y); q.z += k * (qa.z - q.z);
          float n = sqrtf(q.w * q.w + q.x * q.x + q.y * q.y + q.z * q.z); q.w /= n; q.x /= n; q.y /= n; q.z /= n; }
        gyroBias[0] += 0.001f * (gx - gyroBias[0]); gyroBias[1] += 0.001f * (gy - gyroBias[1]); gyroBias[2] += 0.001f * (gz - gyroBias[2]);
        kh *= 0.99f; kv *= 0.99f; p0 += 0.001f * (bme.readPressure() - p0) * (now - lastBaroUs < 1000 ? 1 : 0);
      }
      if (millis() - lastPrintMs > 200) { lastPrintMs = millis(); Serial.printf("pad: tilt %.1f  thP %+.1f  thY %+.1f  h %.2f  cont %.1fV\n", tiltDeg, thP, thY, kh, readContinuity()); }
      if (accG > 2.0f) { if (++belowCount > 30) { tLiftMs = millis(); maxAlt = 0; setState(BOOST); } } else belowCount = 0;   // 30 ms above 2 g
      break; }
    case BENCH_TEST: {   // MOTORS REMOVED. Lean the rocket by hand: nozzle exit must swing AWAY from the lean side
      dPcmd = gimbalCmd(thP, rP, iP, 27.1f, I_ASC, ARM_ASC, dt); dYcmd = gimbalCmd(thY, rY, iY, 27.1f, I_ASC, ARM_ASC, dt);
      if (millis() - lastPrintMs > 200) { lastPrintMs = millis(); Serial.printf("bench: thP %+.1f thY %+.1f -> gimbal P %+.2f Y %+.2f deg\n", thP, thY, dPcmd, dYcmd); }
      break; }
    case BOOST: {
      float F = curveAt(ASC_F, ASC_N, tFlight);
      dPcmd = gimbalCmd(thP, rP, iP, F, I_ASC, ARM_ASC, dt); dYcmd = gimbalCmd(thY, rY, iY, F, I_ASC, ARM_ASC, dt);
      if (F < 2.0f && tFlight > 0.5f) { dPcmd = dYcmd = 0; setState(COAST); }
      break; }
    case COAST:
      dPcmd = dYcmd = 0;
      if ((kv < -1.0f && kh < maxAlt - 1.5f) || tFlight > APOGEE_BACKUP_S) { openFlare(); tumbleMs = 0; setState(DESCENT); }
      break;
    case DESCENT:
      // tumbling well above the decision height: use the chute while there is still height for it
      if (millis() - tStateMs > 2500 && tiltDeg > 60.0f) { if (!tumbleMs) tumbleMs = millis(); if (millis() - tumbleMs > 1500 && kh > DECIDE_M) { deployChute(); setState(FAILSAFE); break; } } else tumbleMs = 0;
      if (kh <= DECIDE_M) {
        float vAtCmd = speedAt(kh, -kv, H_CMD_NOM);
        if (tiltDeg > MAX_TILT_DEG || vAtCmd > SPEED_MAX || vAtCmd < SPEED_MIN) { deployChute(); setState(FAILSAFE); }
        else setState(GO);
      }
      break;
    case GO:
      if (-kv > 1.0f && shouldIgnite(kh, -kv)) {
        if (tiltDeg <= MAX_TILT_DEG && !pyroFired) { firePyro(); tCmdMs = millis(); iP = iY = 0; setState(LANDING_BURN); }
        else { deployChute(); setState(FAILSAFE); }
      }
      break;
    case LANDING_BURN: {
      float tb = (millis() - tCmdMs) / 1000.0f - IGN_DELAY_S;
      float F = curveAt(DES_F, DES_N, tb);
      if (tb > -0.05f) { dPcmd = gimbalCmd(thP, rP, iP, fmaxf(F, 5.0f), I_DES, ARM_DES, dt); dYcmd = gimbalCmd(thY, rY, iY, fmaxf(F, 5.0f), I_DES, ARM_DES, dt); }
      if (tb > DES_N * CURVE_DT + 0.5f && fabsf(kv) < 0.5f) { dPcmd = dYcmd = 0; setState(LANDED); }
      break; }
    case LANDED:
    case FAILSAFE:
    default:
      dPcmd = dYcmd = 0;
      if (millis() - tStateMs > 8000 && logN > 0 && accG < 1.3f) { writeLog(); logN = 0; oledMsg(STATE_NAME[state], "log saved"); }
      break;
  }

  // ---- servos at 100 Hz, log at 100 Hz ----
  if (now - lastServoUs > 10000) { lastServoUs = now; writeServos(dPcmd, dYcmd); }
  if (state >= BOOST && now - lastLogUs > 10000) { lastLogUs = now; logSample(); }
}
